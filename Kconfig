## Kconfig
```kconfig
#
# Copyright (c) 2022 Laird Connectivity LLC
#
# SPDX-License-Identifier: LicenseRef-LairdConnectivity-Clause
#
menuconfig LCZ_MODEM_HL7800
	bool "HL7800 Modem Module"
	depends on MODEM_HL7800
	depends on ATTR
    depends on SYSTEM_MESSAGE_TASK

if LCZ_MODEM_HL7800

module=LCZ_MODEM_HL7800
module-str=LCZ_MODEM_HL7800
source "subsys/logging/Kconfig.template.log_config"

config LCZ_MODEM_HL7800_INIT_PRIORITY
    int "Application level init priority"
    range 0 99
    default APPLICATION_INIT_PRIORITY

config LCZ_MODEM_HL7800_SHELL
    bool "HL7800 shell commands"
    depends on SHELL
    default y if SHELL

endif # LCZ_MODEM_HL7800
```
